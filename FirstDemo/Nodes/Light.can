/*@!Encoding:936*/
includes
{
  
}

variables
{
  
}

on message Msg1 {
  sysSetVariableInt(sysvar::MyNamespace::svLight,this.bsSwitch);
}