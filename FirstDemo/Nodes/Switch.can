/*@!Encoding:936*/
includes
{
  
}

variables
{
  
}

on preStart
{
  write("This is my first CANoe Simulation!\n");
}

on sysvar sysvar::MyNamespace::svSwitch
{
  message Msg1 msg;
  msg.bsSwitch = sysGetVariableInt(sysvar::MyNamespace::svSwitch);
  output(msg);
  
}

